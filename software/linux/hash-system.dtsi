// SPDX-License-Identifier: MIT
// Merge into the Zybo Z7-20 Linux device tree for THIS static build.
// If XSA generation already emitted axi_dma_0, amend that node instead of
// creating a duplicate. Keep the board's PS/DDR/MIO/Ethernet definitions.
&amba {
        hash_dma: dma-controller@40400000 {
            compatible = "xlnx,axi-dma-1.00.a";
            reg = <0x40400000 0x10000>;
            #dma-cells = <1>;
            xlnx,addrwidth = <32>;
            xlnx,sg-length-width = <26>;
            clock-names = "s_axi_lite_aclk", "m_axi_mm2s_aclk";
            clocks = <&clkc 15>, <&clkc 15>;
            interrupt-parent = <&intc>;
            dma-channel@40400000 {
                compatible = "xlnx,axi-dma-mm2s-channel";
                interrupts = <0 29 4>; // IRQ_F2P[0] = GIC IRQ61
                xlnx,datawidth = <64>;
                xlnx,include-dre;
                xlnx,device-id = <0>;
            };
        };
        hash_accelerator: hash-accelerator@43c00000 {
            compatible = "core-forge,hash-accelerator-1.0";
            reg = <0x43c00000 0x1000>;
            dmas = <&hash_dma 0>;
            dma-names = "tx";
            fpga-mgr = <&devcfg>;
            // The shell's IRQ_F2P[1] is available; this driver polls completion.
        };
};
